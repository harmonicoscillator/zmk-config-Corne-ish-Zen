## config/west.yml
```yaml
manifest:
  remotes:
    - name: zmkfirmware
      url-base: https://github.com/harmonicoscillator
  projects:
    - name: zmk
      remote: zmkfirmware
      revision: nodisplay
      import: app/west.yml
  self:
    path: config
```
